## nodes/esp32sCam/camera-node/main/Kconfig.projbuild
```kconfig
menu "BMS ESP32-S-CAM Matter node"

config BMS_CAM_RESERVED
    bool "Reserved project option"
    default n
    help
        Reserved placeholder for future ESP32-S-CAM project options.

endmenu
```

## nodes/esp32sCam/camera-node/sdkconfig.defaults
```kconfig
CONFIG_IDF_TARGET="esp32"

# Flash and PSRAM
# SPIRAM_USE_MALLOC lets Matter/BLE/WiFi large allocations use PSRAM, keeping DRAM
# free for task stacks and DMA buffers. Small allocs stay in DRAM via ALWAYSINTERNAL.
CONFIG_ESPTOOLPY_FLASHSIZE_4MB=y
CONFIG_SPIRAM=y
CONFIG_SPIRAM_USE_MALLOC=y
CONFIG_SPIRAM_MALLOC_ALWAYSINTERNAL=4096

# Partition table — factory layout, no OTA partitions
CONFIG_PARTITION_TABLE_CUSTOM=y
CONFIG_PARTITION_TABLE_CUSTOM_FILENAME="partitions.csv"
CONFIG_PARTITION_TABLE_OFFSET=0x8000

# BLE for Matter commissioning (NimBLE, minimal config)
CONFIG_BT_ENABLED=y
CONFIG_BT_NIMBLE_ENABLED=y
CONFIG_BT_NIMBLE_EXT_ADV=n
CONFIG_BT_NIMBLE_50_FEATURE_SUPPORT=n
CONFIG_BT_NIMBLE_LL_CFG_FEAT_LE_2M_PHY=n
CONFIG_BT_NIMBLE_LL_CFG_FEAT_LE_CODED_PHY=n
CONFIG_BT_NIMBLE_EXT_SCAN=n
CONFIG_BT_NIMBLE_ENABLE_PERIODIC_SYNC=n
CONFIG_BT_NIMBLE_HCI_EVT_BUF_SIZE=70
CONFIG_USE_BLE_ONLY_FOR_COMMISSIONING=n

# Matter over Wi-Fi; no Thread on this board
CONFIG_CUSTOM_DEVICE_INSTANCE_INFO_PROVIDER=y
CONFIG_EXAMPLE_DEVICE_INSTANCE_INFO_PROVIDER=n
CONFIG_ENABLE_WIFI_STATION=y
CONFIG_ENABLE_MATTER_OVER_THREAD=n
CONFIG_ESP_MATTER_ENABLE_OPENTHREAD=n
CONFIG_USE_MINIMAL_MDNS=n
CONFIG_ENABLE_EXTENDED_DISCOVERY=y
CONFIG_DEVICE_VENDOR_ID=0xFFF1
CONFIG_DEVICE_PRODUCT_ID=0x8005
CONFIG_ENABLE_OTA_REQUESTOR=n
CONFIG_CHIP_OTA_IMAGE_BUILD=n
# Keep the node on the standard always-on Matter path; ICD is not needed here.
# CONFIG_SUPPORT_ICD_MANAGEMENT_CLUSTER is not set

# mDNS / DNS-SD — keep Matter operational advertisement alive on DRAM-starved ESP32
CONFIG_MDNS_TASK_STACK_SIZE=3072
CONFIG_MDNS_TASK_CREATE_FROM_SPIRAM=y
CONFIG_MDNS_TASK_CREATE_FROM_INTERNAL=n
CONFIG_MDNS_MEMORY_ALLOC_SPIRAM=y
CONFIG_MDNS_MEMORY_ALLOC_INTERNAL=n
CONFIG_MDNS_ENABLE_CONSOLE_CLI=n
CONFIG_MDNS_PREDEF_NETIF_STA=y
CONFIG_MDNS_PREDEF_NETIF_AP=n
CONFIG_MDNS_PREDEF_NETIF_ETH=n

# Networking
CONFIG_LWIP_IPV4=y
CONFIG_LWIP_IPV6_NUM_ADDRESSES=8
CONFIG_LWIP_MULTICAST_PING=y
CONFIG_LWIP_IPV6_AUTOCONFIG=y
CONFIG_ESP_WIFI_STA_DISCONNECTED_PM_ENABLE=n

# mbedTLS — Matter commissioning crypto
CONFIG_MBEDTLS_CMAC_C=y
CONFIG_MBEDTLS_SSL_PROTO_DTLS=y
CONFIG_MBEDTLS_KEY_EXCHANGE_ECJPAKE=y
CONFIG_MBEDTLS_ECJPAKE_C=y
CONFIG_MBEDTLS_HKDF_C=y

# IRAM — overflow fix: move WiFi ISR code to flash (acceptable latency tradeoff)
CONFIG_WIFI_IRAM_OPT=n
CONFIG_WIFI_RX_IRAM_OPT=n

# FreeRTOS / ringbuf path helpers can live in flash on this target
CONFIG_FREERTOS_PLACE_FUNCTIONS_INTO_FLASH=y
CONFIG_RINGBUF_PLACE_FUNCTIONS_INTO_FLASH=y
CONFIG_FREERTOS_TASK_CREATE_ALLOW_EXT_MEM=y

# System
CONFIG_ESP_MAIN_TASK_STACK_SIZE=8192
```
